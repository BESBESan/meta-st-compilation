## conf/layer.conf
```bitbake
# We have a conf and classes directory, add to BBPATH
BBPATH .= ":${LAYERDIR}"

# We have recipes-* directories, add to BBFILES
BBFILES += "${LAYERDIR}/recipes-*/*/*.bb \
            ${LAYERDIR}/recipes-*/*/*.bbappend"

BBFILE_COLLECTIONS += "meta-st-firmware"
BBFILE_PATTERN_meta-st-firmware = "^${LAYERDIR}/"
BBFILE_PRIORITY_meta-st-firmware = "6"
# Ajouter le tuning Cortex-M4 aux architectures prises en charge
#PACKAGE_EXTRA_ARCHS_append = " cortexm4"

LAYERDEPENDS_meta-st-firmware = "core"
LAYERSERIES_COMPAT_meta-st-firmware = "kirkstone"
```

## conf/machine/include/tune-cortexm4.inc
```bitbake
# Optimisations pour Cortex-M4
TUNE_FEATURES_tune-cortexm4 = "armv7-m cortex-m4 thumb"
TUNE_PKGARCH_tune-cortexm4 = "cortexm4"
TUNE_ARCH = "arm"

# Options du compilateur
TARGET_CC_ARCH = "-mcpu=cortex-m4 -mthumb -mfpu=fpv4-sp-d16 -mfloat-abi=hard"
```

## conf/machine/stm32f407.conf
```bitbake
# STM32F407 machine configuration

# Architecture cible : ARM Cortex-M4
TARGET_ARCH = "arm"

# Inclure les optimisations pour Cortex-M4
require conf/machine/include/tune-cortexm4.inc

# Type de compilation bare-metal
MACHINE_FEATURES = "baremetal"

# Désactiver les composants inutiles (Linux, U-Boot, etc.)
PREFERRED_PROVIDER_virtual/kernel = ""
PREFERRED_PROVIDER_virtual/bootloader = ""
PREFERRED_PROVIDER_virtual/libc = "newlib"

# Dépendances pour l'image minimale
EXTRA_IMAGEDEPENDS = "stm32f407-code"
```
